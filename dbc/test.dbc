VERSION ""

NS_ :

BS_:

BU_:

BO_ 16 VALVE_STATUS: 1 Vector__XXX
	SG_ tank_one : 0|1@1+ (0,0) [0|1] "ON/OFF" Vector__XXX
	SG_ tank_two : 1|1@1+ (0,0) [0|1] "ON/OFF" Vector__XXX

BO_ 17 PRESSURE: 8 Vector__XXX
	SG_ tank_press : 0|32@1+ (0.001,0) [0|0] "Bar" Vector__XXX
	SG_ brake_press : 32|32@1+ (0.001,0) [0|0] "Bar" Vector__XXX

BO_ 18 FORCE: 8 Vector__XXX
	SG_ tank_force : 0|32@1+ (0.001,0) [0|0] "N" Vector__XXX
	SG_ brake_force : 32|32@1+ (0.001,0) [0|0] "N" Vector__XXX

BO_ 19 VOLTAGE: 8 Vector__XXX
	SG_ tank_volt : 0|32@1+ (1.00001,0) [0|0] "V" Vector__XXX
	SG_ brake_volt : 32|32@1+ (0.00001,0) [0|0] "V" Vector__XXX

BO_ 20 RAW: 4 Vector__XXX
	SG_ tank_raw : 0|16@1+ (1,0) [0|0] "" Vector__XXX
	SG_ brake_raw : 16|16@1+ (1,0) [0|0] "" Vector__XXX

CM_ SG_ 20 tank_raw "adc value";
CM_ SG_ 20 brake_raw "adc value";
